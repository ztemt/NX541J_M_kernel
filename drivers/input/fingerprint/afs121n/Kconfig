## drivers/input/touchscreen/mediatek/atmel/Kconfig
```kconfig
#
# Atmel mXT I2C Touchscreen driver
#

config MXT_DEBUG_ENABLE
	bool "Debug message"
	depends on CONFIG_TOUCHSCREEN_MTK_ATMEL
	default n
	help
	  This is the plugin manger

	  Select here if you have a debug message

config MXT_PLUGIN_SUPPORT
	bool "Plugin manager"
	depends on CONFIG_TOUCHSCREEN_MTK_ATMEL
	default n
	help
	  This is the plugin manger

	  Select here if you have a this plugin

if MXT_PLUGIN_SUPPORT

config MXT_PLIGIN_CAL
	bool "Calibraion recovery support - (cal)"
	depends on MXT_PLUGIN_SUPPORT
	default n
	help
	  This is the calibraion plugin

	  Select here if you have a this plugin

config MXT_PLIGIN_AC
	bool "Charger detect support - (ac)"
	depends on MXT_PLUGIN_SUPPORT
	default n
	help
	  This is the charger plugin

	  Select here if you have a this plugin

config MXT_PLIGIN_PI
	bool "Alternative config support - (pi)"
	depends on MXT_PLUGIN_SUPPORT
	default n
	help
	  This is the alternative plugin

	  Select here if you have a this plugin

config MXT_PLIGIN_MISC
	bool "Miscellaneous feature support - (misc)"
	depends on MXT_PLUGIN_SUPPORT
	default n
	help
	  This is the miscellaneous plugin

	  Select here if you have a this plugin

config MXT_PLIGIN_CLIP
	bool "clip feature support - (clip)"
	depends on MXT_PLUGIN_SUPPORT
	default n
	help
	  This is the clip plugin

	  Select here if you have a this plugin

config MXT_PLIGIN_WDG
	bool "Watch dog support - (wdg)"
	depends on MXT_PLUGIN_SUPPORT
	default n
	help
	  This is the watch dog plugin

	  Select here if you have a this plugin
endif
```

## drivers/misc/drv2605/Kconfig
```kconfig
config DRV2605
	bool "TI DRV2605"
	default n

config FEATURE_ZTEMT_DRV2605_COMPATIBLE
        bool "TI DRV2605 compatible with MTK PMIC Vibrator"
        depends on DRV2605
        default n
        help
         Compatible with MTK PMIC Vibrator
```

## drivers/misc/mediatek/alsps/APDS9930-new/Kconfig
```kconfig
config MTK_APDS9930_NEW
	bool "APDS9930_NEW for MediaTek package"
	default n
	help
	It support different type sensor
	in this platform. If this option
	is set, it will support ambient
	and light sensor APDS9930.

config NUBIA_APDS9930_NEW_ALS_CONT_VALUE
+       bool "Enable APDS9930_NEW als continuous value"
+       default n
```

## drivers/misc/mediatek/alsps/bh1745/Kconfig
```kconfig
config MTK_ROHM_BH1745
  bool "MTK_ROHM_BH1745"
  help
	  ALSPS sensor driverto detect ambint light and the object is close
	  or far awary from device
```

## drivers/misc/mediatek/gyroscope/lsm6ds3gy/Kconfig
```kconfig
config MTK_LSM6DS3GY
        bool "BMI120 for MediaTek package"
        default n
        help
        It support different gyroscope sensor.
        If this option is set,
	  	it will support
         LSM6DS3 gyroscope.
```

## drivers/misc/mediatek/nubia_sensor/Kconfig
```kconfig
################################################# HALL START
config NUBIA_SENSORS_HALL_DEVICE
	tristate "hall device driver"
	default n
	help
	  If you say yes here you get support for
	  hall device

config NUBIA_SENSORS_SINGLE_HALL_DEVICE
        tristate "single hall device"
        depends on NUBIA_SENSORS_HALL_DEVICE
        default n
        help
          If you say yes here you get support for
          single hall device

config ZTEMT_HALL_DEVICE_DTS
        tristate "hall device dts"
        depends on NUBIA_SENSORS_HALL_DEVICE
        default n
        help
          If you say yes here you get support for
          hall device dts
```
